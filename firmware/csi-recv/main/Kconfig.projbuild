## firmware/csi-recv/main/Kconfig.projbuild
```kconfig
menu "wifi-sensing-edge"

    config WIFI_SSID
        string "WiFi SSID"
        default "myssid"
        help
            SSID of the 2.4 GHz access point to associate with.

    config WIFI_PASSWORD
        string "WiFi password"
        default "mypassword"
        help
            Password of the access point.

endmenu
```

## firmware/csi-recv/sdkconfig.defaults
```kconfig
CONFIG_IDF_TARGET="esp32s3"

CONFIG_ESP_CONSOLE_UART_BAUDRATE=921600
CONFIG_ESP_CONSOLE_UART_DEFAULT=y

CONFIG_FREERTOS_HZ=1000

CONFIG_ESP32S3_DEFAULT_CPU_FREQ_240=y

CONFIG_ESP_TASK_WDT_TIMEOUT_S=10

CONFIG_LOG_DEFAULT_LEVEL_INFO=y
```
